## boards/arm/puhkb2/Kconfig.board
```kconfig
# nrfmicro board configuration

# Copyright (c) 2020 The ZMK Contributors
# SPDX-License-Identifier: MIT

config BOARD_PUHKB2_1
    bool "puhkb2_1"
    depends on SOC_NRF52840_QIAA
```

## boards/arm/puhkb2/Kconfig.defconfig
```kconfig
# Electronut Labs Papyr board configuration

# Copyright (c) 2020 The ZMK Contributors
# SPDX-License-Identifier: MIT

if BOARD_PUHKB2_1

config BOARD
    default "puhkb2"

if USB_DEVICE_STACK

config USB_NRFX
    default y

endif # USB_DEVICE_STACK

config BT_CTLR
    default BT

endif # BOARD_PUHKB2_1
```

## boards/shields/puhkb/Kconfig.defconfig
```kconfig
# Copyright (c) 2020 Ryan Cross
# SPDX-License-Identifier: MIT

if SHIELD_PUHKB_LEFT

config ZMK_KEYBOARD_NAME
    default "puhkb"

config ZMK_SPLIT_ROLE_CENTRAL
    default y

endif

if SHIELD_PUHKB_LEFT || SHIELD_PUHKB_RIGHT

config ZMK_SPLIT
    default y
    
config ZMK_RGB_UNDERGLOW
    select WS2812_STRIP
    select SPI
    
if ZMK_DISPLAY

config SSD1306
    default y

config I2C
    default y

endif # ZMK_DISPLAY

if LVGL

config LV_Z_VDB_SIZE
    default 64

config LV_DPI_DEF
    default 148

config LV_Z_BITS_PER_PIXEL
    default 1

choice LV_COLOR_DEPTH
    default LV_COLOR_DEPTH_1
endchoice

endif # LVGL

endif
```

## boards/shields/puhkb/Kconfig.shield
```kconfig
# Copyright (c) 2020 Ryan Cross
# SPDX-License-Identifier: MIT

config SHIELD_PUHKB_LEFT
    def_bool $(shields_list_contains,puhkb_left)

config SHIELD_PUHKB_RIGHT
    def_bool $(shields_list_contains,puhkb_right)
```

## boards/shields/puhkb2/Kconfig.defconfig
```kconfig
# Copyright (c) 2020 Ryan Cross
# SPDX-License-Identifier: MIT

if SHIELD_PUHKB2_LEFT

config ZMK_KEYBOARD_NAME
    default "PUHKB3"

config ZMK_SPLIT_ROLE_CENTRAL
    default y

endif

if SHIELD_PUHKB2_LEFT || SHIELD_PUHKB2_RIGHT

config ZMK_SPLIT
    default y
    
endif
```

## boards/shields/puhkb22s/Kconfig.defconfig
```kconfig
# Copyright (c) 2020 Ryan Cross
# SPDX-License-Identifier: MIT

if SHIELD_PUHKB2_DONGLE

config ZMK_KEYBOARD_NAME
    default "PUHKB2"

config ZMK_SPLIT_ROLE_CENTRAL
    default y

endif

if SHIELD_PUHKB2_DONGLE || SHIELD_PUHKB2_LEFT || SHIELD_PUHKB2_RIGHT || SHIELD_PUHKB2_NUMPAD

config ZMK_SPLIT
    default y
    
endif
```

## boards/shields/puhkb2s/Kconfig.shield
```kconfig
# Copyright (c) 2020 Ryan Cross
# SPDX-License-Identifier: MIT

config SHIELD_PUHKB2_LEFT
    def_bool $(shields_list_contains,puhkb2_left)

config SHIELD_PUHKB2_RIGHT
    def_bool $(shields_list_contains,puhkb2_right)

config SHIELD_PUHKB2_NUMPAD
    def_bool $(shields_list_contains,puhkb2_numpad)
```
