## boards/shields/puhkb4/Kconfig.defconfig
```kconfig
# Copyright (c) 2020 Ryan Cross
# SPDX-License-Identifier: MIT

if SHIELD_PUHKB4_LEFT

config ZMK_KEYBOARD_NAME
    default "PUHKB4"

config ZMK_SPLIT_ROLE_CENTRAL
    default y

endif

if SHIELD_PUHKB4_LEFT || SHIELD_PUHKB4_RIGHT || SHIELD_PUHKB4_NUMPAD

config ZMK_SPLIT
    default y
    
endif
```

## boards/shields/puhkb4/Kconfig.shield
```kconfig
# Copyright (c) 2020 Ryan Cross
# SPDX-License-Identifier: MIT

config SHIELD_PUHKB2_LEFT
    def_bool $(shields_list_contains,puhkb4_left)

config SHIELD_PUHKB2_RIGHT
    def_bool $(shields_list_contains,puhkb4_right)

config SHIELD_PUHKB2_NUMPAD
    def_bool $(shields_list_contains,puhkb4_numpad)
```

## boards/shields/puhkb4num/Kconfig.defconfig
```kconfig
# Copyright (c) 2020 Ryan Cross
# SPDX-License-Identifier: MIT

if SHIELD_PUHKB4_NUMPAD
	config ZMK_KEYBOARD_NAME
		default "PUHKB4NUM"
endif
```

## boards/shields/puhkb4num/Kconfig.shield
```kconfig
# Copyright (c) 2020 Ryan Cross
# SPDX-License-Identifier: MIT

config SHIELD_PUHKB4_NUMPAD
    def_bool $(shields_list_contains,puhkb4_numpad)
```
