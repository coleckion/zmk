/*
 * Copyright (c) 2020 Ryan Cross
 *
 * SPDX-License-Identifier: MIT
 */
 
#include "puhkb2.dtsi"

    &kscan0 {
        row-gpios
        	= <&gpio0 9 (GPIO_ACTIVE_HIGH | GPIO_PULL_DOWN)>
        	;
	col-gpios
		= <&gpio0 10 GPIO_ACTIVE_HIGH>
		;
    };
