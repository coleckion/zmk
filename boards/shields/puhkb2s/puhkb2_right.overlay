/*
 * Copyright (c) 2020 Ryan Cross
 *
 * SPDX-License-Identifier: MIT
 */

#include "puhkb2.dtsi"

&default_transform {
    col-offset = <8>;
};

    &kscan0 {
        row-gpios
            = <&gpio0 8 (GPIO_ACTIVE_HIGH | GPIO_PULL_DOWN)>
            , <&gpio0 13 (GPIO_ACTIVE_HIGH | GPIO_PULL_DOWN)>
            , <&gpio0 24 (GPIO_ACTIVE_HIGH | GPIO_PULL_DOWN)>
            , <&gpio1 9 (GPIO_ACTIVE_HIGH | GPIO_PULL_DOWN)>
            ;
		col-gpios
			= <&gpio0 6 GPIO_ACTIVE_HIGH>
			, <&gpio0 17 GPIO_ACTIVE_HIGH>
			, <&gpio0 20 GPIO_ACTIVE_HIGH>
			, <&gpio0 22 GPIO_ACTIVE_HIGH>
			, <&gpio1 6 GPIO_ACTIVE_HIGH>
			, <&gpio1 4 GPIO_ACTIVE_HIGH>
			, <&gpio1 2 GPIO_ACTIVE_HIGH>
			, <&gpio1 0 GPIO_ACTIVE_HIGH>
			;
    };
